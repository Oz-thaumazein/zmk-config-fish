## config/boards/shields/fish/Kconfig.defconfig
```kconfig
# Copyright (c) 2021 The ZMK Contributors
# SPDX-License-Identifier: MIT

CONFIG_ZMK_COMBO_MAX_COMBOS_PER_KEY=50

if SHIELD_FISH_LEFT
# 右親機にしたければ "if SHIELD_FISH_RIGHT" にする

config ZMK_KEYBOARD_NAME
    default "Fish Keyboard"

config ZMK_SPLIT_ROLE_CENTRAL
    default y

endif


if SHIELD_FISH_LEFT || SHIELD_FISH_RIGHT

config ZMK_SPLIT
    default y

endif
```
